/dts-v1/;


/plugin/;

/ {
	fragment@0 {
		target-path = "/";
		__overlay__ {
			instance-create {
				instance-name = "qemu-demo";
				id = <1>;
				resources {
					cpus = <2>;
					memory-bytes = /bits/ 64 <0x10000000>;
				};
			};
		};
	};
};
